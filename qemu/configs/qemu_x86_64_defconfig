## qemu/configs/qemu_x86_64_defconfig
```kconfig
#!/usr/bin/env bash
VERSION=( ${1//./ } )
cat << EOF
# Linux headers same as kernel
BR2_PACKAGE_HOST_LINUX_HEADERS_CUSTOM_${VERSION[0]}_${VERSION[1]}=y

# Linux kernel
BR2_LINUX_KERNEL_CONFIG_FRAGMENT_FILES="../qemu/configs/kernel_config_fragment"
BR2_LINUX_KERNEL_CUSTOM_VERSION_VALUE="$1"
BR2_PACKAGE_GLIBC=y

# Toolchain options
BR2_TOOLCHAIN_USES_GLIBC=y
BR2_TOOLCHAIN_BUILDROOT_GLIBC=y
BR2_TOOLCHAIN_BUILDROOT_LIBC="glibc"
BR2_TOOLCHAIN_BUILDROOT_CXX=y
BR2_TOOLCHAIN_BUILDROOT_WCHAR=y
BR2_USE_WCHAR=y
BR2_ENABLE_DEBUG=y
BR2_PTHREAD_DEBUG=y
BR2_TOOLCHAIN_HAS_THREADS=y
BR2_TOOLCHAIN_HAS_THREADS_DEBUG=y
BR2_TOOLCHAIN_HAS_THREADS_NPTL=y

# ccache
BR2_CCACHE=y

# GDB
BR2_PACKAGE_HOST_GDB=y
BR2_PACKAGE_GDB=y
BR2_PACKAGE_GDB_SERVER=y

# rootfs overlay
BR2_ROOTFS_OVERLAY="../rootfs_overlay"

# OpenSSH
BR2_PACKAGE_OPENSSH=y

BR2_PACKAGE_HOST_ENVIRONMENT_SETUP=y

EOF
```
